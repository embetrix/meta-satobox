## conf/distro/satobox.conf
```bitbake
############################################
# satobox distro Layer configuration
############################################

#include and overwrite default poky distro
include conf/distro/poky.conf
DISTRO = "satobox"
DISTRO_NAME = "satobox Linux"
INHERIT += "satobox-version"
DISTRO_VERSION := "${SATOBOX_DISTRO_VERSION}"
DISTRO_CODENAME = "Genesis"

IMAGE_VERSION_SUFFIX = "_${DISTRO_VERSION}"

SDK_VERSION="${DISTRO_VERSION}"

MAINTAINER = "Embetrix <ayoub.zaki@embetrix.com>"

TARGET_VENDOR = "-satobox"

# Override these in poky based distros
SATOBOX_DEFAULT_DISTRO_FEATURES = "${POKY_DEFAULT_DISTRO_FEATURES} systemd usrmerge acl xattr zeroconf"
SATOBOX_DEFAULT_EXTRA_RDEPENDS = "packagegroup-core-boot"
SATOBOX_DEFAULT_EXTRA_RRECOMMENDS = "kernel-module-af-packet"

DISTRO_EXTRA_RDEPENDS += " ${SATOBOX_DEFAULT_EXTRA_RDEPENDS}"
DISTRO_EXTRA_RRECOMMENDS += " ${SATOBOX_DEFAULT_EXTRA_RRECOMMENDS}"

DISTRO_FEATURES = "${SATOBOX_DEFAULT_DISTRO_FEATURES} ${DISTRO_FEATURES_DEFAULT}"
DISTRO_FEATURES:remove=" alsa irda pcmcia nfc nfs 3g debuginfod bluetooth multiarch vulkan x11 ptest"

# Use systemd as init manager
VIRTUAL-RUNTIME_init_manager = "systemd"

# Default u-boot-fw-utils
PREFERRED_PROVIDER_u-boot-fw-utils = "libubootenv"

# Overwrite machine config
include conf/machine/${MACHINE}-extra.conf


# Use custom image link
IMAGE_NAME = "${IMAGE_BASENAME}-${MACHINE}${IMAGE_VERSION_SUFFIX}"
IMAGE_LINK_NAME = "${IMAGE_BASENAME}"

# # Ship a kernel with bundled initramfs
# INITRAMFS_IMAGE  ?= "satobox-image-initramfs"
# INITRAMFS_IMAGE_NAME ?= "satobox-image-initramfs"
# INITRAMFS_IMAGE_BUNDLE ?= "1"

LICENSE_FLAGS_ACCEPTED = "synaptics-killswitch"

SDKMACHINE = "x86_64"

CLANGSDK = "1"

TOOLCHAIN_HOST_TASK:append = " nativesdk-libclang"

PACKAGE_CLASSES = "package_deb"

INHERIT += "rm_work"
```

## conf/machine/raspberrypi4-64-extra.conf
```bitbake
# Allow overriding the default machine configuration from meta-raspberrypi
INITRAMFS_IMAGE_BUNDLE = "0"
INITRAMFS_IMAGE = ""

#RPI_USE_U_BOOT = "1"
ENABLE_UART = "1"
BOOT_DELAY = "0"
BOOT_DELAY_MS = "0"
DISABLE_SPLASH = "1"
GPU_FREQ = "250"
DISABLE_VC4GRAPHICS = "1"
ENABLE_I2C = "1"

CMDLINE:append = " loglevel=7 rw"

RPI_KERNEL_DEVICETREE += " \
    broadcom/bcm2711-rpi-4-b.dtb \
    broadcom/bcm2711-rpi-400.dtb \
    broadcom/bcm2711-rpi-cm4.dtb \
"

MACHINE_EXTRA_RRECOMMENDS += "\
    bcm2835 rpi-config userland u-boot-env \
    linux-firmware-rpidistro-bcm43455 \
    bluez-firmware-rpidistro-bcm4345c0-hcd \
"

IMAGE_BOOT_FILES += "${KERNEL_IMAGETYPE};${SDIMG_KERNELIMAGE}"

WKS_FILE_DEPENDS += " \
                    virtual/bootloader \
                    e2fsprogs-native \
                    "

WKS_FILES = "satobox.wks"
```

## conf/machine/raspberrypi5-extra.conf
```bitbake
RPI_KERNEL_DEVICETREE_OVERLAYS:append = " overlays/bcm2712d0.dtbo"
ENABLE_UART = "1"
RPI_EXTRA_CONFIG = ' \n \
# Enable PCIe/NVMe \n \
dtparam=pciex1_gen=3 \n \
# Enable Uart \n \
dtparam=uart0_console \n \
'

CMDLINE:append = " console=ttyAMA0,115200 loglevel=7 rw"

MACHINE_EXTRA_RRECOMMENDS += "\
    rpi-config \
    rpi-eeprom \
    u-boot-env \
"

IMAGE_BOOT_FILES += "${KERNEL_IMAGETYPE}-${INITRAMFS_LINK_NAME}.bin;${SDIMG_KERNELIMAGE}"


WKS_FILES = "satobox.wks"
```

## meta-satobox/conf/distro/satobox.conf
```bitbake
############################################
# satobox distro Layer configuration
############################################

#include and overwrite default poky distro
include conf/distro/poky.conf
DISTRO = "satobox"
DISTRO_NAME = "satobox Linux"
INHERIT += "satobox-version"
DISTRO_VERSION := "${SATOBOX_DISTRO_VERSION}"
DISTRO_CODENAME = "Genesis"

IMAGE_VERSION_SUFFIX = "_${DISTRO_VERSION}"

SDK_VERSION="${DISTRO_VERSION}"

MAINTAINER = "Embetrix <ayoub.zaki@embetrix.com>"

TARGET_VENDOR = "-satobox"

# Override these in poky based distros
SATOBOX_DEFAULT_DISTRO_FEATURES = "systemd usrmerge acl xattr zeroconf security integrity"
SATOBOX_DEFAULT_EXTRA_RDEPENDS = "packagegroup-core-boot"
SATOBOX_DEFAULT_EXTRA_RRECOMMENDS = "kernel-module-af-packet"

DISTRO_EXTRA_RDEPENDS += " ${SATOBOX_DEFAULT_EXTRA_RDEPENDS}"
DISTRO_EXTRA_RRECOMMENDS += " ${SATOBOX_DEFAULT_EXTRA_RRECOMMENDS}"

DISTRO_FEATURES:append = " ${SATOBOX_DEFAULT_DISTRO_FEATURES}"
DISTRO_FEATURES:remove = " alsa irda pcmcia nfc nfs 3g debuginfod bluetooth multiarch opengl pulseaudio wayland vulkan x11 ptest"

# Use systemd as init manager
VIRTUAL-RUNTIME_init_manager = "systemd"
VIRTUAL-RUNTIME_initscripts = ""
VIRTUAL-RUNTIME_syslog = ""
VIRTUAL-RUNTIME_login_manager = "shadow-base"
DISTRO_FEATURES_BACKFILL_CONSIDERED = "sysvinit"

# Default u-boot-fw-utils
PREFERRED_PROVIDER_u-boot-fw-utils = "libubootenv"

# Overwrite machine config
include conf/machine/${MACHINE}-extra.conf

# default bitcoin rpc credentials
BITCOIND_RPC_USER   ?= "_rpcuser_"
BITCOIND_RPC_PASSWD ?= "_rpcpasswd_"

# Use custom image link
IMAGE_CHAIN_SUFFIX = "${@bb.utils.contains('DISTRO_FEATURES', 'mainnet', '-mainnet', '-signet', d)}"
IMAGE_NAME = "${IMAGE_BASENAME}${IMAGE_CHAIN_SUFFIX}-${MACHINE}${IMAGE_VERSION_SUFFIX}"
IMAGE_LINK_NAME = "${IMAGE_BASENAME}"

# Ship a kernel with bundled initramfs
INITRAMFS_IMAGE  = "satobox-image-initramfs"
INITRAMFS_IMAGE_NAME = "${INITRAMFS_IMAGE}"
INITRAMFS_LINK_NAME = "${MACHINE}"
INITRAMFS_IMAGE_BUNDLE = "1"

LICENSE_FLAGS_ACCEPTED = "synaptics-killswitch"

SDKMACHINE = "x86_64"

CLANGSDK = "1"

TOOLCHAIN_HOST_TASK:append = " nativesdk-libclang"

PACKAGE_CLASSES = "package_deb"

INHERIT += "rm_work"
```

## meta-satobox/conf/machine/qemux86-64-extra.conf
```bitbake
## Support efi
MACHINE_FEATURES:append = " efi"
EFI_PROVIDER = "grub-efi"

MACHINE_EXTRA_RRECOMMENDS += " ovmf"

IMAGE_FSTYPES += "wic wic.bmap"
WKS_FILES = "satobox-genericx86-64.wks"
```

## meta-satobox/conf/machine/raspberrypi4-64-extra.conf
```bitbake
#RPI_USE_U_BOOT = "1"
ENABLE_UART = "1"
BOOT_DELAY = "0"
BOOT_DELAY_MS = "0"
DISABLE_SPLASH = "1"
GPU_FREQ = "250"
DISABLE_VC4GRAPHICS = "1"
ENABLE_I2C = "1"

CMDLINE:append = " loglevel=7 rw"

RPI_KERNEL_DEVICETREE += " \
    broadcom/bcm2711-rpi-4-b.dtb \
    broadcom/bcm2711-rpi-400.dtb \
    broadcom/bcm2711-rpi-cm4.dtb \
"

MACHINE_EXTRA_RRECOMMENDS += "\
    rpi-config \
    rpi-eeprom \
    u-boot-env \
"

IMAGE_BOOT_FILES += "${KERNEL_IMAGETYPE}-${INITRAMFS_LINK_NAME}.bin;${SDIMG_KERNELIMAGE}"

WKS_FILES = "satobox.wks"
```

## meta-satobox/conf/machine/raspberrypi5-extra.conf
```bitbake
#
# raspberrypi5 machine extra configuration
#

ENABLE_UART = "1"
RPI_USE_U_BOOT = "1"
RPI_EXTRA_CONFIG = ' \n \
# Enable PCIe/NVMe \n \
dtparam=pciex1_gen=3 \n \
# Enable Uart \n \
dtparam=uart0_console \n \
# Enable Watchdog \n \
dtparam=watchdog=on \n \
'

CMDLINE:append = " console=ttyAMA0,115200 loglevel=7 ro"
#CMDLINE:append = " console=ttyAMA10,115200 earlycon=pl011,0x107d001000,115200n8 loglevel=7 rw"

#CMDLINE_ROOT_PARTITION = "/dev/mmcblk0p4"
CMDLINE_ROOTFS = "rootwait"

MACHINE_EXTRA_RRECOMMENDS += "\
    rpi-config \
    rpi-eeprom \
    raspi-utils \
    u-boot-env \
    u-boot-fw-utils \
"

# RPI Secure boot settings
RPI_SECBOOT_SIGN = "1"
RPI_SECBOOT_KEY_DIR = "${SATOBOX_BASE}/conf/keys/devel/secure-boot"
RPI_SECBOOT_SIGN_KEY = "${RPI_SECBOOT_KEY_DIR}/secure-boot-sign.key"

# Module signing settings
MODSIGN_KEY_DIR = "${SATOBOX_BASE}/conf/keys/devel/kmod"
MODSIGN_PRIVKEY = "${MODSIGN_KEY_DIR}/kmod-sign.key"
MODSIGN_X509    = "${MODSIGN_KEY_DIR}/kmod-sign.crt"

# Enable FIT image support
KERNEL_CLASSES  += "kernel-fitimage"
KERNEL_IMAGETYPES += "fitImage"
KERNEL_IMAGETYPE_UBOOT = "fitImage"
KERNEL_BOOTCMD = "bootm"

UBOOT_LOADADDRESS = "0x01080000"
UBOOT_ENTRYPOINT  = "0x01080000"

# U-Boot FIT image sign settings
UBOOT_SIGN_ENABLE = "1"
UBOOT_SIGN_KEYDIR = "${SATOBOX_BASE}/conf/keys/devel/fitimage"
UBOOT_SIGN_KEYNAME = "fitimage-sign"


# IMA/EVM settings
IMAGE_CLASSES:append = " ima-evm-rootfs"
IMA_EVM_KEYDIR  = "${SATOBOX_BASE}/conf/keys/devel/ima-evm"
IMA_EVM_PRIVKEY = "${IMA_EVM_KEYDIR}/ima-evm.key"
IMA_EVM_X509    = "${IMA_EVM_KEYDIR}/ima-evm.der"

# Exclude fitImage from IMAGE_BOOT_FILES
IMAGE_BOOT_FILES:remove = " fitImage"

# Exclude fitImage from boot.img
SECBOOT_FILES_EXCLUDE = " fitImage"

# include boot.img and its signature in IMAGE_BOOT_FILES
IMAGE_BOOT_FILES:append = " boot.img boot.sig"
IMAGE_CLASSES:append = " rpi-secboot"
IMAGE_FSTYPES += "rpi-secboot ext4.gz"
IMAGE_FSTYPES:remove = " ext3"

WKS_FILES = "satobox.wks"
```

## meta-satobox/wic/satobox.wks
```
# description: Create a disk image
part /             --ondisk mmcblk0  --label bootA      --fixed-size 100M   --fstype=vfat   --source bootimg-partition  --active --align 4096
part /             --ondisk mmcblk0  --label bootB      --fixed-size 100M   --fstype=vfat   --source bootimg-partition
part /             --ondisk mmcblk0  --label rootA      --fixed-size 2048M  --fstype=ext4   --source rootfs
part /             --ondisk mmcblk0  --label rootB      --fixed-size 2048M  --fstype=ext4
part /             --ondisk mmcblk0  --label data       --fixed-size 1024M  --fstype=ext4
part /             --ondisk mmcblk0  --label wallets    --fixed-size 1024M  --fstype=ext4
part /             --ondisk mmcblk0  --label backups    --fixed-size 1024M  --fstype=ext4
part /             --ondisk mmcblk0  --label bitcoin    --fixed-size 24576M --fstype=ext4
bootloader --ptable gpt
```

## wic/satobox-genericx86-64.wks
```
# description: Create an EFI disk image for genericx86*
part /             --ondisk sda  --label efi        --fixed-size 50M    --source bootimg-efi --sourceparams="loader=grub-efi" --active --align 1024
part /             --ondisk sda  --label primary    --fixed-size 1024M  --fstype=ext4   --source rootfs
part /             --ondisk sda  --label secondary  --fixed-size 1024M  --fstype=ext4   --source rootfs
part /             --ondisk sda  --label data       --fixed-size 1024M  --fstype=ext4
part /             --ondisk sda  --label wallets    --fixed-size 1024M  --fstype=ext4
part /             --ondisk sda  --label backups    --fixed-size 1024M  --fstype=ext4
part /             --ondisk sda  --label bitcoin    --fixed-size 24576M --fstype=ext4
bootloader --ptable gpt --configfile=grub.cfg
```

## wic/satobox.wks
```
# description: Create a disk image
part /             --ondisk mmcblk0  --label boot       --fixed-size 100M   --fstype=vfat  --source bootimg-partition  --active --align 4096
part /             --ondisk mmcblk0  --label primary    --fixed-size 2048M  --fstype=ext4   --source rootfs
part /             --ondisk mmcblk0  --label secondary  --fixed-size 2048M  --fstype=ext4
part /             --ondisk mmcblk0  --label data       --fixed-size 1024M  --fstype=ext4
part /             --ondisk mmcblk0  --label wallets    --fixed-size 1024M  --fstype=ext4
part /             --ondisk mmcblk0  --label backups    --fixed-size 1024M  --fstype=ext4
part /             --ondisk mmcblk0  --label bitcoin    --fixed-size 24576M --fstype=ext4
bootloader --ptable gpt
```
